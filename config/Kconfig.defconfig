## config/Kconfig.defconfig
```kconfig
# Copyright (c) 2020 The ZMK Contributors
# SPDX-License-Identifier: MIT

if SHIELD_RAVEN42

config ZMK_KEYBOARD_NAME
    default "Raven42"

endif
```

## config/Kconfig.shield
```kconfig
# Copyright (c) 2020 The ZMK Contributors
# SPDX-License-Identifier: MIT

config SHIELD_RAVEN42
    def_bool $(shields_list_contains,tg4x)
```
